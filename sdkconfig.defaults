## sdkconfig.defaults
```kconfig
# Default ESP-IDF configuration for Sign Language Translation Glove

# Enable FreeRTOS stats formatting functions
CONFIG_FREERTOS_USE_TRACE_FACILITY=y
CONFIG_FREERTOS_GENERATE_RUN_TIME_STATS=y

# Increase CPU frequency to 240MHz for better performance
CONFIG_ESP32S3_DEFAULT_CPU_FREQ_MHZ=240

# Enable PSRAM
CONFIG_SPIRAM=y
CONFIG_SPIRAM_BANKSWITCH_ENABLE=y
CONFIG_SPIRAM_SPEED_80M=y
CONFIG_SPIRAM_CACHE_WORKAROUND=y
CONFIG_SPIRAM_SIZE=8388608

# Increase ESP32-S3 Main XTAL frequency to 40MHz
CONFIG_ESP32S3_XTAL_FREQ_40=y

# Bluetooth configuration
# CONFIG_BT_ENABLED=y
# CONFIG_BTDM_CTRL_MODE_BLE_ONLY=y
# CONFIG_BTDM_CTRL_MODE_BR_EDR_ONLY=n
# CONFIG_BTDM_CTRL_MODE_BTDM=n
# CONFIG_BT_BLUEDROID_ENABLED=y
# CONFIG_BT_BLE_ENABLED=y
# CONFIG_BT_GATTS_ENABLE=y

# Wi-Fi disabled to save power (can be enabled if needed)
CONFIG_ESP32_WIFI_ENABLED=n

# Camera configuration
CONFIG_CAMERA_CORE0=y
CONFIG_OV2640_SUPPORT=y
CONFIG_OV7725_SUPPORT=n
CONFIG_OV3660_SUPPORT=n
CONFIG_OV5640_SUPPORT=n

# I2S configuration for audio
CONFIG_EXAMPLE_I2S_NUM=0
CONFIG_I2S_ISR_IRAM=y

# ADC configuration
CONFIG_ADC_CAL_EFUSE_TP_ENABLE=y
CONFIG_ADC_CAL_EFUSE_VREF_ENABLE=y
CONFIG_ADC_CAL_LUT_ENABLE=y

# Flash SPI mode
CONFIG_ESPTOOLPY_FLASHMODE_QIO=y
CONFIG_ESPTOOLPY_FLASHFREQ_80M=y

# Increase log buffer size for better debug output
CONFIG_LOG_DEFAULT_LEVEL_INFO=y
CONFIG_LOG_COLORS=y

# Partition table
CONFIG_PARTITION_TABLE_CUSTOM=y
CONFIG_PARTITION_TABLE_CUSTOM_FILENAME="partitions.csv"

# FreeRTOS configurations
CONFIG_FREERTOS_HZ=1000
CONFIG_FREERTOS_IDLE_TASK_STACKSIZE=1536

# Stack sizes for tasks
CONFIG_ESP_MAIN_TASK_STACK_SIZE=4096
CONFIG_ESP_SYSTEM_EVENT_TASK_STACK_SIZE=4096

# Memory check options
CONFIG_HEAP_POISONING_DISABLED=y
CONFIG_HEAP_TASK_TRACKING=y

# Enable Hardware WDT
CONFIG_ESP_TASK_WDT=y

# NVS configuration
CONFIG_NVS_ENCRYPTION=n

# TensorFlow Lite Micro configurations
CONFIG_TFLM_ENABLE=y
CONFIG_TFLM_OPTIMIZED=y

# Display (OLED) configurations
CONFIG_I2C_MANAGER_0_ENABLE=y
CONFIG_I2C_MANAGER_0_GPIO_SDA=21
CONFIG_I2C_MANAGER_0_GPIO_SCL=22
CONFIG_I2C_MANAGER_0_FREQ_HZ=400000

# Additional memory configurations
CONFIG_SPIRAM_MALLOC_ALWAYSINTERNAL=4096
CONFIG_SPIRAM_TRY_ALLOCATE_WIFI_LWIP=y
CONFIG_SPIRAM_MALLOC_RESERVE_INTERNAL=32768

CONFIG_SPIFFS_CREATE_PARTITION=y
CONFIG_SPIFFS_USE_MAGIC=y
CONFIG_SPIFFS_PAGE_SIZE=256
CONFIG_SPIFFS_CACHE=y
```
